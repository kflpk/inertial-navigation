## CMakeLists.txt
```
# SPDX-License-Identifier: Apache-2.0

cmake_minimum_required(VERSION 3.20.0)
find_package(Zephyr REQUIRED HINTS $ENV{ZEPHYR_BASE})
project(marg)

target_sources(app PRIVATE src/main.c)
target_sources(app PRIVATE src/mpu6050.c)
target_sources(app PRIVATE src/hmc5883l.c)
target_sources(app PRIVATE src/remote.c)
```

## prj.conf
```kconfig
CONFIG_GPIO=y
CONFIG_DK_LIBRARY=y

CONFIG_I2C=y
CONFIG_CBPRINTF_FP_SUPPORT=y

CONFIG_LOG=y
CONFIG_LOG_DEFAULT_LEVEL=3

# for math standard library
CONFIG_NEWLIB_LIBC=y

# BLUETOOTH
CONFIG_BT=y
CONFIG_BT_PERIPHERAL=y
CONFIG_BT_DEVICE_NAME="MARG"
CONFIG_BT_DEVICE_APPEARANCE=0
CONFIG_BT_MAX_CONN=1
CONFIG_BT_LL_SOFTDEVICE=y


CONFIG_ASSERT=y
```

## src/main.c
```c
/*
 * Copyright (c) 2016 Intel Corporation
 *
 * SPDX-License-Identifier: Apache-2.0
 */

#include <zephyr/kernel.h>
#include <zephyr/drivers/gpio.h>
#include <zephyr/devicetree.h>
#include <zephyr/drivers/i2c.h>
#include <zephyr/logging/log.h>
#include <dk_buttons_and_leds.h>

#include "config.h"
#include "mpu6050.h"
#include "hmc5883l.h"
#include "remote.h"
#include "callbacks.h"

#define SLEEP_TIME_MS   1000
#define I2C_NODE DT_NODELABEL(i2c0)
#define BT_STATUS_LED DK_LED1
#define SENSOR_LED  DK_LED2
#define LOG_SENSORS true

LOG_MODULE_REGISTER(app);


static const struct device *i2c_dev = DEVICE_DT_GET(I2C_NODE);
static uint8_t  i2c_buf[6];
static uint16_t acc_data[3];
static uint16_t gyro_data[3];
static uint16_t mag_data[3];
uint16_t* sensor_data;
static struct bt_conn* current_conn;


void button_handler(uint32_t button_state, uint32_t has_changed) {
	uint8_t button_value = 0;
	if(button_state & has_changed) {
		switch(has_changed) {
			case DK_BTN1_MSK:
				button_value = 1;
			break;
			case DK_BTN2_MSK:
				button_value = 2;
			break;
			case DK_BTN3_MSK:
				button_value = 3;
			break;
			case DK_BTN4_MSK:
				button_value = 4;
			break;
		}
		LOG_INF("button pressed: %d", button_value);
		set_button_value(button_value);
	}
}

void init_buttons_and_leds() {
	int ret;
	ret = dk_buttons_init(button_handler);
	if(ret) {
		LOG_ERR("Couldn't init buttons, err: %d", ret);
	}
	ret = dk_leds_init();
	if(ret) {
		LOG_ERR("Couldn't init LEDs, err: %d", ret);
	}
}

void on_connected(struct bt_conn* conn, uint32_t err) {
    if(err) {
        LOG_ERR("connection err: %d", err);
		return;
    }
	LOG_INF("Bluetooth connected");
	current_conn = bt_conn_ref(conn);
	dk_set_led_on(BT_STATUS_LED);
}

void on_disconnected(struct bt_conn* conn, uint32_t reason) {
	LOG_INF("Disconnected, reason: 0x%x", reason);
	dk_set_led_off(BT_STATUS_LED);
	if(current_conn) {
		bt_conn_unref(current_conn);
		current_conn = NULL;
	}
}

struct bt_conn_cb bluetooth_callbacks = {
	.connected = on_connected,
	.disconnected = on_disconnected
};

void main(void) {
	int ret;
	
	if( !(ret = device_is_ready(i2c_dev)) ) {
		LOG_ERR("I2C device not ready, returned with code %d", ret);
	} else {
		LOG_DBG("I2C device is ready");
	}

	init_buttons_and_leds();
	MPU_init(i2c_dev);
	HMC_init(i2c_dev);
	ret = bluetooth_init(&bluetooth_callbacks);

	sensor_data = (uint16_t*)get_buffer_addr();

	if(LOG_SENSORS == false) {
		while(true)
			k_msleep(SLEEP_TIME_MS);
	}

	while(true) {
		k_msleep(100);
	
	 	dk_set_led_on(SENSOR_LED);
		ret = MPU_read_acc(sensor_data);
		if(ret) {
			LOG_ERR("Error while reading acc");
		}

		ret = MPU_read_gyro(sensor_data + 3);
		if(ret) {
			LOG_ERR("Error while reading gyro");
		}

		ret = HMC_read_mag(sensor_data + 6);
		if(ret) {
			LOG_ERR("Error while reading mag");
		}
		dk_set_led_off(SENSOR_LED);

		LOG_INF("acc:  %f, %f, %f", 
		(float)(ACC_SCALE_FACTOR)*(int16_t)sensor_data[0], 
		(float)(ACC_SCALE_FACTOR)*(int16_t)sensor_data[1], 
		(float)(ACC_SCALE_FACTOR)*(int16_t)sensor_data[2]);

		LOG_INF("gyro: %f, %f, %f",
		(float)(GYRO_SCALE_FACTOR)*(int16_t)sensor_data[3], 
		(float)(GYRO_SCALE_FACTOR)*(int16_t)sensor_data[4], 
		(float)(GYRO_SCALE_FACTOR)*(int16_t)sensor_data[5]);

		LOG_INF("mag:  %f, %f, %f", 
		(float)(MAG_SCALE_FACTOR)*(int16_t)sensor_data[6],
		(float)(MAG_SCALE_FACTOR)*(int16_t)sensor_data[7],
		(float)(MAG_SCALE_FACTOR)*(int16_t)sensor_data[8]);
	}

}
```

## src/callbacks.h
```c
#ifndef CALLBACKS_H
#define CALLBACKS_H

#include "remote.h"

void on_connected(struct bt_conn* conn, uint32_t err);
void on_disconnected(struct bt_conn* conn, uint32_t reason);

#endif
```

## src/hmc5883l.h
```c
#ifndef HCM5883L_H
#define HCM5883L_H

#include <zephyr/kernel.h>
#include <zephyr/drivers/gpio.h>
#include <zephyr/devicetree.h>
#include <zephyr/drivers/i2c.h>
#include <zephyr/logging/log.h>
#include <zephyr/math/ilog2.h>
#include <math.h>
#include "config.h"


#define HMC_GAIN 0b101
#define MAG_SCALE_FACTOR 2.56

// #define HMC_i2c_addr 	0x7E
#define HMC_i2c_addr 	(0x1E)


#define HMC_CONFIG_REG_A    0
#define HMC_CONFIG_REG_B    1
#define HMC_MODE_REG        2
#define HMC_X_HIGH          3
#define HMC_X_LOW           4
#define HMC_Y_HIGH          5
#define HMC_Y_LOW           6
#define HMC_Z_HIGH          7
#define HMC_Z_LOW           8
#define HMC_STATUS_REG      9
#define HMC_ID_REG_A        10
#define HMC_ID_REG_B        11
#define HMC_ID_REG_C        12

#define HMC_DATA_START HMC_X_HIGH

typedef enum {
    continuous = 0b00,
    single = 0b01,
    idle = 0b11
} HMC_mode_t;

uint8_t HMC_init(const struct device *i2c_device);
uint8_t HMC_read_mag(int16_t output[]);
uint8_t HMC_set_mode(HMC_mode_t mode, bool high_speed);
uint8_t HMC_set_gain(uint8_t gain);

#endif
```

## src/mpu6050.c
```c
#include "mpu6050.h"

static struct device *i2c_dev;
static uint8_t i2c_buffer[6];

uint8_t MPU_init(const struct device *i2c_device) {
    // TODO: make this prettier
    i2c_dev = i2c_device;

    i2c_buffer[0] = SMPLRT_DIV_REG;
    i2c_buffer[1] = 7;
    i2c_write(i2c_dev, i2c_buffer, 2, MPU_i2c_addr);

    i2c_buffer[0] = PWR_MGMT_1_REG;
    i2c_buffer[1] = 1;
    i2c_write(i2c_dev, i2c_buffer, 2, MPU_i2c_addr);

    i2c_buffer[0] = CONFIG_REG;
    i2c_buffer[1] = 0;
    i2c_write(i2c_dev, i2c_buffer, 2, MPU_i2c_addr);

    i2c_buffer[0] = GYRO_CONFIG_REG;
    i2c_buffer[1] = 24;
    i2c_write(i2c_dev, i2c_buffer, 2, MPU_i2c_addr);

    i2c_buffer[0] = ACC_CONFIG_REG;
    i2c_buffer[1] = AFS_SEL << 3;
    i2c_write(i2c_dev, i2c_buffer, 2, MPU_i2c_addr);

    i2c_buffer[0] = GYRO_CONFIG_REG;
    i2c_buffer[1] = FS_SEL << 3;
    i2c_write(i2c_dev, i2c_buffer, 2, MPU_i2c_addr);

    i2c_buffer[0] = INT_ENABLE_REG;
    i2c_buffer[1] = 1;
    i2c_write(i2c_dev, i2c_buffer, 2, MPU_i2c_addr);

    // Enable I2C pass-through mode
    i2c_buffer[0] = INT_PIN_CFG_REG;
    i2c_buffer[1] = (1 << I2C_BYPASS_EN);
    i2c_write(i2c_dev, i2c_buffer, 2, MPU_i2c_addr);

    i2c_buffer[0] = USER_CTRL_REG;
    i2c_buffer[1] = 0;
    i2c_write(i2c_dev, i2c_buffer, 2, MPU_i2c_addr);

    return 0;
}

uint8_t MPU_read_acc(int16_t output[3]) {
    i2c_buffer[0] = ACC_REG_START;

    uint8_t ret = i2c_write(i2c_dev, i2c_buffer, 1, MPU_i2c_addr);

    if(ret) {
        return ret;
    }

    ret = i2c_read(i2c_dev, i2c_buffer, 6, MPU_i2c_addr);
    if(ret) {
        return ret;
    }

    for(uint8_t i = 0; i < 3; i++) {
        output[i] = (i2c_buffer[2 * i] << 8) | i2c_buffer[2 * i + 1];
    }

    return 0;
}

// FIX: this absolutely violated the DRY rule, but i can fix it later
uint8_t MPU_read_gyro(int16_t output[]) {
    i2c_buffer[0] = GYRO_REG_START;

    uint8_t ret = i2c_write(i2c_dev, i2c_buffer, 1, MPU_i2c_addr);

    if(ret) {
        return ret;
    }

    ret = i2c_read(i2c_dev, i2c_buffer, 6, MPU_i2c_addr);
    if(ret) {
        return ret;
    }

    for(uint8_t i = 0; i < 3; i++) {
        output[i] = (i2c_buffer[2 * i] << 8) | i2c_buffer[2 * i + 1];
    }

    return 0;
}
```

## src/remote.c
```c
#include "remote.h"

#define LOG_MODULE_NAME remote
LOG_MODULE_REGISTER(remote);

static K_SEM_DEFINE(bt_init_ok, 1, 1); // i dunno what it does

#define DEVICE_NAME CONFIG_BT_DEVICE_NAME
#define DEVICE_NAME_LEN (sizeof(DEVICE_NAME - 1) )

static uint8_t sensor_buffer[18] = {0, 0, 0, 0, 0, 0, 0, 0, 0, 0, 0, 0, 0, 0, 0, 0, 0, 0};

static const struct bt_data ad[] = {
    BT_DATA_BYTES(BT_DATA_FLAGS, (BT_LE_AD_GENERAL | BT_LE_AD_NO_BREDR)),
    BT_DATA(BT_DATA_NAME_COMPLETE, DEVICE_NAME, DEVICE_NAME_LEN)
};

static const struct bt_data sd[] = {
    BT_DATA_BYTES(BT_DATA_UUID128_ALL, BT_UUID_REMOTE_SERV_VAL)
};

/* ========== CALLBACKS =========== */
void bt_ready(int err) {
    if(err) {
        LOG_ERR("bt_enable returned %d", err);
    } else {
        LOG_DBG("bluetooth enabled");
    }
    k_sem_give(&bt_init_ok);
}

static ssize_t read_button_characteristic_cb(struct bt_conn* conn, const struct bt_gatt_attr* attr, void* buf, uint16_t len, uint16_t offset) {
    return bt_gatt_attr_read(conn, attr, buf, len, offset, sensor_buffer, sizeof(sensor_buffer));
}

BT_GATT_SERVICE_DEFINE(remote_srv, 
BT_GATT_PRIMARY_SERVICE(BT_UUID_REMOTE_SERVICE),
    BT_GATT_CHARACTERISTIC(BT_UUID_REMOTE_IMU_CHRC,
        BT_GATT_CHRC_READ,
        BT_GATT_PERM_READ,
        read_button_characteristic_cb, NULL, NULL),
    // BT_GATT_CHARACTERISTIC(BT_UUID_REMOTE_GYRO_CHRC,
    //     BT_GATT_CHRC_READ,
    //     BT_GATT_PERM_READ,
    //     read_button_characteristic_cb, NULL, NULL),
    // BT_GATT_CHARACTERISTIC(BT_UUID_REMOTE_MAG_CHRC,
    //     BT_GATT_CHRC_READ,
    //     BT_GATT_PERM_READ,
    //     read_button_characteristic_cb, NULL, NULL),
);



int bluetooth_init(struct bt_conn_cb* callbacks) {
    int err;
    LOG_INF("Initializing bluetooth");

    if(callbacks != NULL) {
        bt_conn_cb_register(callbacks);
    } else {
        return NRFX_ERROR_NULL;
    }

    err = bt_enable(bt_ready);
    if(err) { 
        LOG_ERR("bt_enable returned %d", err);
        return err;
    }

    k_sem_take(&bt_init_ok, K_FOREVER);

    err = bt_le_adv_start(BT_LE_ADV_CONN, ad, ARRAY_SIZE(ad), sd, ARRAY_SIZE(sd));
    if(err) {
        LOG_ERR("Couldn't start advertising (err: %d)", err);
        return err;
    }
    LOG_INF("Bluetooth started advertising");

    return err;
}

void set_button_value(int value) {
    sensor_buffer[0] = value;
}

uint8_t* get_buffer_addr(void) { 
    return sensor_buffer;
}
```

## src/remote.h
```c
#include <zephyr/kernel.h>
#include <zephyr/logging/log.h>

#include <zephyr/bluetooth/bluetooth.h>
#include <zephyr/bluetooth/uuid.h>
#include <zephyr/bluetooth/gatt.h>
#include <zephyr/bluetooth/hci.h>


#define BT_UUID_REMOTE_SERV_VAL \
    BT_UUID_128_ENCODE(0x21370001, 0x2137, 0x2137, 0x2137, 0x213721372137)
// #define BT_UUID_REMOTE_BUTTON_CHRC_VAL \
//     BT_UUID_128_ENCODE(0x21370002, 0x2137, 0x2137, 0x2137, 0x213721372137)

#define BT_UUID_REMOTE_IMU_CHRC_VAL \
    BT_UUID_128_ENCODE(0x21370005, 0x2137, 0x2137, 0x2137, 0x213721372137)
// #define BT_UUID_REMOTE_GYRO_CHRC_VAL \
//     BT_UUID_128_ENCODE(0x21370003, 0x2137, 0x2137, 0x2137, 0x213721372137)
// #define BT_UUID_REMOTE_MAG_CHRC_VAL \
//     BT_UUID_128_ENCODE(0x21370004, 0x2137, 0x2137, 0x2137, 0x213721372137)

#define BT_UUID_REMOTE_SERVICE     BT_UUID_DECLARE_128(BT_UUID_REMOTE_SERV_VAL)
// #define BT_UUID_REMOTE_BUTTON_CHRC BT_UUID_DECLARE_128(BT_UUID_REMOTE_BUTTON_CHRC_VAL)
#define BT_UUID_REMOTE_IMU_CHRC  BT_UUID_DECLARE_128(BT_UUID_REMOTE_IMU_CHRC_VAL)
// #define BT_UUID_REMOTE_GYRO_CHRC BT_UUID_DECLARE_128(BT_UUID_REMOTE_GYRO_CHRC_VAL)
// #define BT_UUID_REMOTE_MAG_CHRC  BT_UUID_DECLARE_128(BT_UUID_REMOTE_MAG_CHRC_VAL)


int bluetooth_init(struct bt_conn_cb* callbacks);
void set_button_value(int value);
uint8_t* get_buffer_addr(void);
```
