## CMakeLists.txt
```
# SPDX-License-Identifier: Apache-2.0

cmake_minimum_required(VERSION 3.20.0)
find_package(Zephyr REQUIRED HINTS $ENV{ZEPHYR_BASE})
project(blinky)

target_sources(app PRIVATE src/main.c)
target_sources(app PRIVATE src/mpu6050.c)
target_sources(app PRIVATE src/hmc5883l.c)
target_sources(app PRIVATE src/remote.c)
```

## prj.conf
```kconfig
CONFIG_GPIO=y
CONFIG_DK_LIBRARY=y

CONFIG_I2C=y
CONFIG_CBPRINTF_FP_SUPPORT=y

CONFIG_LOG=y
CONFIG_LOG_DEFAULT_LEVEL=4

# for math standard library
CONFIG_NEWLIB_LIBC=y

# BLUETOOTH
CONFIG_BT=y
CONFIG_BT_PERIPHERAL=y
CONFIG_BT_DEVICE_NAME="MARG"
CONFIG_BT_DEVICE_APPEARANCE=0
CONFIG_BT_MAX_CONN=1
CONFIG_BT_LL_SOFTDEVICE=y


CONFIG_ASSERT=y
```

## nrf52840dk_nrf52840.overlay
```dts
// To get started, press Ctrl+Space to bring up the completion menu and view the available nodes.

// You can also use the buttons in the sidebar to perform actions on nodes.
// Actions currently available include:

// * Enabling / disabling the node
// * Adding the bus to a bus
// * Removing the node
// * Connecting ADC channels

// For more help, browse the DeviceTree documentation at https://docs.zephyrproject.org/latest/guides/dts/index.html
// You can also visit the nRF DeviceTree extension documentation at https://nrfconnect.github.io/vscode-nrf-connect/devicetree/nrfdevicetree.html

// &i2c0 {
//     sda-pin = <26>;
//     scl-pin = <27>;
// };
```

## src/main.c
```c
/*
 * Copyright (c) 2016 Intel Corporation
 *
 * SPDX-License-Identifier: Apache-2.0
 */

#include <zephyr/kernel.h>
#include <zephyr/drivers/gpio.h>
#include <zephyr/devicetree.h>
#include <zephyr/drivers/i2c.h>
#include <zephyr/logging/log.h>
#include <dk_buttons_and_leds.h>

#include "config.h"
#include "mpu6050.h"
#include "hmc5883l.h"
#include "remote.h"
#include "callbacks.h"

#define SLEEP_TIME_MS   1000
#define I2C_NODE DT_NODELABEL(i2c0)
#define BT_STATUS_LED DK_LED1

LOG_MODULE_REGISTER(app);


static const struct device *i2c_dev = DEVICE_DT_GET(I2C_NODE);
static uint8_t  i2c_buf[6];
static uint16_t acc_data[3];
static uint16_t gyro_data[3];
static uint16_t mag_data[3];
static struct bt_conn* current_conn;


void button_handler(uint32_t button_state, uint32_t has_changed) {
	if(button_state & has_changed) {
		switch(has_changed) {
			case DK_BTN1_MSK:
				dk_set_led(DK_LED1, 1);
			break;
			case DK_BTN2_MSK:
				dk_set_led(DK_LED2, 1);
			break;
			case DK_BTN3_MSK:
				dk_set_led(DK_LED3, 1);
			break;
			case DK_BTN4_MSK:
				dk_set_led(DK_LED4, 1);
			break;
		}
	}
}

void init_buttons_and_leds() {
	int ret;
	ret = dk_buttons_init(button_handler);
	if(ret) {
		LOG_ERR("Couldn't init buttons, err: %d", ret);
	}
	ret = dk_leds_init();
	if(ret) {
		LOG_ERR("Couldn't init LEDs, err: %d", ret);
	}
}
void on_connected(struct bt_conn* conn, uint32_t err) {
    if(err) {
        LOG_ERR("connection err: %d", err);
		return;
    }
	LOG_INF("Bluetooth connected");
	current_conn = bt_conn_ref(conn);
	dk_set_led_on(BT_STATUS_LED);
}

void on_disconnected(struct bt_conn* conn, uint32_t reason) {
	LOG_INF("Disconnected, reason: 0x%x", reason);
	dk_set_led_off(BT_STATUS_LED);
	if(current_conn) {
		bt_conn_unref(current_conn);
		current_conn = NULL;
	}
}

struct bt_conn_cb bluetooth_callbacks = {
	.connected = on_connected,
	.disconnected = on_disconnected
};

void main(void) {
	int ret;
	
	if( !(ret = device_is_ready(i2c_dev)) ) {
		LOG_ERR("I2C device not ready, returned with code %d", ret);
	} else {
		LOG_DBG("I2C device is ready");
	}

	init_buttons_and_leds();
	MPU_init(i2c_dev);
	HMC_init(i2c_dev);
	ret = bluetooth_init(&bluetooth_callbacks);

	while(true) {
		k_msleep(SLEEP_TIME_MS);
	
		ret = MPU_read_acc(acc_data);
		if(ret) {
			LOG_ERR("Error while reading acc");
		}

		ret = MPU_read_gyro(gyro_data);
		if(ret) {
			LOG_ERR("Error while reading gyro");
		}

		ret = HMC_read_mag(mag_data);
		if(ret) {
			LOG_ERR("Error while reading mag");
		}

		LOG_INF("acc:  %f, %f, %f", 
		(float)(ACC_SCALE_FACTOR)*(int16_t)acc_data[0], 
		(float)(ACC_SCALE_FACTOR)*(int16_t)acc_data[1], 
		(float)(ACC_SCALE_FACTOR)*(int16_t)acc_data[2]);

		LOG_INF("gyro: %f, %f, %f",
		(float)(GYRO_SCALE_FACTOR)*(int16_t)gyro_data[0], 
		(float)(GYRO_SCALE_FACTOR)*(int16_t)gyro_data[1], 
		(float)(GYRO_SCALE_FACTOR)*(int16_t)gyro_data[2]);

		LOG_INF("mag:  %f, %f, %f", 
		(float)(MAG_SCALE_FACTOR)*(int16_t)mag_data[0],
		(float)(MAG_SCALE_FACTOR)*(int16_t)mag_data[1],
		(float)(MAG_SCALE_FACTOR)*(int16_t)mag_data[2]);

	}

}
```

## src/config.h
```c
#ifndef GY_86_CONFIG_H
#define GY_86_CONFIG_H





#endif
```

## src/hmc5883l.c
```c
#include "hmc5883l.h"
#include <zephyr/logging/log.h>

static struct device *i2c_dev;
static uint8_t i2c_buffer[64];

LOG_MODULE_REGISTER(HMC5883L);

uint8_t HMC_init(const struct device *i2c_device)
{
    i2c_dev = i2c_device;

    uint8_t ret;
    uint8_t config_reg_a[2] = {HMC_CONFIG_REG_A, 0x70};
    uint8_t config_reg_b[2] = {HMC_CONFIG_REG_B, (HMC_GAIN << 5)};

    LOG_DBG("initializing HMC");

    // i2c_buffer[1] = (0b00 << 0) | (0b100 << 2) | (0b00 << 5);
    ret = i2c_write(i2c_dev, config_reg_a, 2, HMC_i2c_addr);
    if (ret)
    {
        LOG_ERR("Couldn't write to HMC_CONFIG_REG_A, ret: %d", ret);
        return ret;
    }

    // i2c_buffer[1] = (0b000 << 5);
    i2c_write(i2c_dev, config_reg_b, 2, HMC_i2c_addr);
    if (ret) {
        LOG_ERR("Couldn't write to HMC_CONFIG_REG_B, ret: %d", ret);
        return ret;
    }

    ret = HMC_set_mode(continuous, false);
    if (ret) {
        LOG_ERR("Couldn't set mode of HMC, ret: %d", ret);
        return ret;
    }

    LOG_DBG("HMC initialized");

    return 0;
}

uint8_t HMC_read_mag(int16_t output[])
{
    int ret;

    uint8_t data_start_reg[1] = {HMC_DATA_START};
    uint8_t data[6];

    ret = i2c_write(i2c_dev, data_start_reg, 1, HMC_i2c_addr);
    if(ret) {
        return ret;
    }

    ret = i2c_read(i2c_dev, data, 6, HMC_i2c_addr);
    if (ret)
    {
        return ret;
    }

    for (uint8_t i = 0; i < 3; i++) {
        output[i] = (data[2 * i] << 8) | (data[2 * i + 1]);
    }
}

uint8_t HMC_set_mode(HMC_mode_t mode, bool high_speed) {
    uint8_t ret;
    uint8_t mode_val = high_speed ? 0b11111100 : 0b00000000;
    mode_val |= (uint8_t)mode;
    uint8_t mode_reg[2] = {HMC_MODE_REG, mode_val};

    ret = i2c_write(i2c_dev, mode_reg, 2, HMC_i2c_addr);

    return ret;
}

uint8_t HMC_get_status() {
    uint8_t status, ret;
    uint8_t status_reg[1] = {HMC_STATUS_REG};

    i2c_write(i2c_dev, status_reg, 1, HMC_i2c_addr);

    i2c_read(i2c_dev, i2c_buffer, 1, HMC_i2c_addr);

    status = i2c_buffer[0];

    return status;
}

uint8_t HMC_set_gain(uint8_t gain) {
    uint8_t config_reg_b[2] = { HMC_CONFIG_REG_B, (gain << 5) };
    return i2c_write(i2c_dev, config_reg_b, 2, HMC_i2c_addr);
}

uint8_t HMC_get_gain(void) {
    uint8_t* gain;
    uint8_t config_reg_b[1] = { HMC_CONFIG_REG_B };
    
    i2c_write(i2c_dev, config_reg_b, 1, HMC_i2c_addr);
    i2c_read(i2c_dev,  gain,         1, HMC_i2c_addr);

    return *gain;
}
```

## src/hmc5883l.h
```c
#ifndef HCM5883L_H
#define HCM5883L_H

#include <zephyr/kernel.h>
#include <zephyr/drivers/gpio.h>
#include <zephyr/devicetree.h>
#include <zephyr/drivers/i2c.h>
#include <zephyr/logging/log.h>
#include <zephyr/math/ilog2.h>
#include <math.h>
#include "config.h"

// #define HMC_i2c_addr 	0x7E
#define HMC_i2c_addr 	(0b0111100)
#define HMC_i2c_addr 	(0x3C >> 1)
#define HMC_i2c_addr 	(0x1E)


#define HMC_CONFIG_REG_A    0
#define HMC_CONFIG_REG_B    1
#define HMC_MODE_REG        2
#define HMC_X_HIGH          3
#define HMC_X_LOW           4
#define HMC_Y_HIGH          5
#define HMC_Y_LOW           6
#define HMC_Z_HIGH          7
#define HMC_Z_LOW           8
#define HMC_STATUS_REG      9
#define HMC_ID_REG_A        10
#define HMC_ID_REG_B        11
#define HMC_ID_REG_C        12

#define HMC_DATA_START HMC_X_HIGH

typedef enum {
    continuous = 0b00,
    single = 0b01,
    idle = 0b11
} HMC_mode_t;

uint8_t HMC_init(const struct device *i2c_device);
uint8_t HMC_read_mag(int16_t output[]);
uint8_t HMC_set_mode(HMC_mode_t mode, bool high_speed);

#endif
```

## src/mpu6050.c
```c
#include "mpu6050.h"

static struct device *i2c_dev;
static uint8_t i2c_buffer[6];

uint8_t MPU_init(const struct device *i2c_device) {
    // TODO: make this prettier
    i2c_dev = i2c_device;

    i2c_buffer[0] = SMPLRT_DIV_REG;
    i2c_buffer[1] = 7;
    i2c_write(i2c_dev, i2c_buffer, 2, MPU_i2c_addr);

    i2c_buffer[0] = PWR_MGMT_1_REG;
    i2c_buffer[1] = 1;
    i2c_write(i2c_dev, i2c_buffer, 2, MPU_i2c_addr);

    i2c_buffer[0] = CONFIG_REG;
    i2c_buffer[1] = 0;
    i2c_write(i2c_dev, i2c_buffer, 2, MPU_i2c_addr);

    i2c_buffer[0] = GYRO_CONFIG_REG;
    i2c_buffer[1] = 24;
    i2c_write(i2c_dev, i2c_buffer, 2, MPU_i2c_addr);

    i2c_buffer[0] = ACC_CONFIG_REG;
    i2c_buffer[1] = AFS_SEL << 3;
    i2c_write(i2c_dev, i2c_buffer, 2, MPU_i2c_addr);

    i2c_buffer[0] = GYRO_CONFIG_REG;
    i2c_buffer[1] = FS_SEL << 3;
    i2c_write(i2c_dev, i2c_buffer, 2, MPU_i2c_addr);

    i2c_buffer[0] = INT_ENABLE_REG;
    i2c_buffer[1] = 1;
    i2c_write(i2c_dev, i2c_buffer, 2, MPU_i2c_addr);

    return 0;
}

uint8_t MPU_read_acc(int16_t output[3]) {
    i2c_buffer[0] = ACC_REG_START;

    uint8_t ret = i2c_write(i2c_dev, i2c_buffer, 1, MPU_i2c_addr);

    if(ret) {
        return ret;
    }

    ret = i2c_read(i2c_dev, i2c_buffer, 6, MPU_i2c_addr);
    if(ret) {
        return ret;
    }

    for(uint8_t i = 0; i < 3; i++) {
        output[i] = (i2c_buffer[2 * i] << 8) | i2c_buffer[2 * i + 1];
    }

    return 0;
}

// FIX: this absolutely violated the DRY rule, but i can fix it later
uint8_t MPU_read_gyro(int16_t output[]) {
    i2c_buffer[0] = GYRO_REG_START;

    uint8_t ret = i2c_write(i2c_dev, i2c_buffer, 1, MPU_i2c_addr);

    if(ret) {
        return ret;
    }

    ret = i2c_read(i2c_dev, i2c_buffer, 6, MPU_i2c_addr);
    if(ret) {
        return ret;
    }

    for(uint8_t i = 0; i < 3; i++) {
        output[i] = (i2c_buffer[2 * i] << 8) | i2c_buffer[2 * i + 1];
    }

    return 0;
}
```

## src/mpu6050.h
```c
#ifndef MPU6050_H
#define MPU6050_H

#include <zephyr/kernel.h>
#include <zephyr/drivers/gpio.h>
#include <zephyr/devicetree.h>
#include <zephyr/drivers/i2c.h>
#include <zephyr/logging/log.h>
#include <zephyr/math/ilog2.h>
#include <math.h>
#include "config.h"


#define AD0 0
#define MPU_i2c_addr 	0b1101000 | (AD0)

#define PWR_MGMT_1_REG  0x6B
#define SMPLRT_DIV_REG  0x19
#define CONFIG_REG      0x1A
#define INT_ENABLE_REG  0x38

// ======= ACCELEROMETER ======= //
// Accelerometer range
#define AFS_SEL 1
/*
     @brief sensitivity scale factor in LSB per g
*/
#define ACC_LSB_PER_G (16384.0f / pow(2, AFS_SEL))
#define ACC_SCALE_FACTOR (pow(2, AFS_SEL) / 16384.0)


/**
  * @brief
  * Address of accelerometer config register.
  * Bit 7: XA_ST
  * Bit 6: YA_ST
  * Bit 5: ZA_ST
  * Bits 4-3: AFS_SEL[1:0]
*/
#define ACC_CONFIG_REG 0x1C

/**
  * @brief
  * Address of the first register with accelerometer data.
  * The values are layed out in the order of X, Y, Z, with
  * 16 bits per axix in Big Endian (MSB first).
*/
#define ACC_REG_START 0x3B

// ======= GYROSCOPE ========= //

// Gyroscope range
#define FS_SEL 1
#define GYRO_SCALE_FACTOR (pow(2, FS_SEL) / 131.0)

/**
  * @brief
  * Address of the first register with gyroscope data.
  * The values are layed out in the order of X, Y, Z, with
  * 16 bits per axix in Big Endian (MSB first).
*/
#define GYRO_REG_START 0x43

/**
  * @brief
  * Address of gyroscope config register.
  * Bit 7: XG_ST
  * Bit 6: YG_ST
  * Bit 5: ZG_ST
  * Bits 4-3: FS_SEL[1:0]
*/
#define GYRO_CONFIG_REG 0x1B

#define INT_PIN_CFG_REG 0x37
#define I2C_BYPASS_EN 1

#define USER_CTRL_REG 0x6A
#define I2C_MST_EN 5

uint8_t MPU_init(const struct device *i2c_device);
uint8_t MPU_read_acc(int16_t output[]);
uint8_t MPU_read_gyro(int16_t output[]);

#endif
```

## src/remote.c
```c
#include "remote.h"

#define LOG_MODULE_NAME remote
LOG_MODULE_REGISTER(remote);

static K_SEM_DEFINE(bt_init_ok, 1, 1); // i dunno what it does

#define DEVICE_NAME CONFIG_BT_DEVICE_NAME
#define DEVICE_NAME_LEN (sizeof(DEVICE_NAME - 1) )

static uint8_t button_value = 0;

static const struct bt_data ad[] = {
    BT_DATA_BYTES(BT_DATA_FLAGS, (BT_LE_AD_GENERAL | BT_LE_AD_NO_BREDR)),
    BT_DATA(BT_DATA_NAME_COMPLETE, DEVICE_NAME, DEVICE_NAME_LEN)
};

static const struct bt_data sd[] = {
    BT_DATA_BYTES(BT_DATA_UUID128_ALL, BT_UUID_REMOTE_SERV_VAL)
};

/* ========== CALLBACKS =========== */
void bt_ready(int err) {
    if(err) {
        LOG_ERR("bt_enable returned %d", err);
    } else {
        LOG_DBG("bluetooth enabled");
    }
    k_sem_give(&bt_init_ok);
}

static ssize_t read_button_characteristic_cb(struct bt_conn* conn, const struct bt_gatt_attr* attr, void* buf, uint16_t len, uint16_t offset) {
    return bt_gatt_attr_read(conn, attr, buf, len, offset, &button_value, sizeof(button_value));
}

BT_GATT_SERVICE_DEFINE(remote_srv, 
BT_GATT_PRIMARY_SERVICE(BT_UUID_REMOTE_SERVICE),
    BT_GATT_CHARACTERISTIC(BT_UUID_REMOTE_BUTTON_CHRC,
        BT_GATT_CHRC_READ,
        BT_GATT_PERM_READ,
        read_button_characteristic_cb, NULL, NULL),
);



int bluetooth_init(struct bt_conn_cb* callbacks) {
    int err;
    LOG_INF("Initializing bluetooth");

    if(callbacks != NULL) {
        bt_conn_cb_register(callbacks);
    } else {
        return NRFX_ERROR_NULL;
    }

    err = bt_enable(bt_ready);
    if(err) { 
        LOG_ERR("bt_enable returned %d", err);
        return err;
    }

    k_sem_take(&bt_init_ok, K_FOREVER);

    err = bt_le_adv_start(BT_LE_ADV_CONN, ad, ARRAY_SIZE(ad), sd, ARRAY_SIZE(sd));
    if(err) {
        LOG_ERR("Couldn't start advertising (err: %d)", err);
        return err;
    }
    LOG_INF("Bluetooth started advertising");

    return err;
}

void set_button_value(int value) {
    button_value = value;
}
```

## src/remote.h
```c
#include <zephyr/kernel.h>
#include <zephyr/logging/log.h>

#include <zephyr/bluetooth/bluetooth.h>
#include <zephyr/bluetooth/uuid.h>
#include <zephyr/bluetooth/gatt.h>
#include <zephyr/bluetooth/hci.h>


#define BT_UUID_REMOTE_SERV_VAL \
    BT_UUID_128_ENCODE(0xE9EA0001, 0xE19B, 0x482D, 0x9293, 0xC7907585FC48)

#define BT_UUID_REMOTE_BUTTON_CHRC_VAL \
    BT_UUID_128_ENCODE(0xE9EA0002, 0xE19B, 0x482D, 0x9293, 0xC7907585FC48)

#define BT_UUID_REMOTE_SERVICE     BT_UUID_DECLARE_128(BT_UUID_REMOTE_SERV_VAL)
#define BT_UUID_REMOTE_BUTTON_CHRC BT_UUID_DECLARE_128(BT_UUID_REMOTE_BUTTON_CHRC_VAL)

int bluetooth_init(struct bt_conn_cb* callbacks);
void set_button_value(int value);
```
